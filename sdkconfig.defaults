## sdkconfig.defaults
```kconfig
CONFIG_ESP32_REV_MIN_1=y
CONFIG_ESP_DEFAULT_CPU_FREQ_MHZ_240=y
# Can't use SRAM1 for IRAM as it conflict with un-updatable bootloaders in the wild :@ .
# CONFIG_ESP_SYSTEM_ESP32_SRAM1_REGION_AS_IRAM=y
CONFIG_ESP_CONSOLE_UART_CUSTOM=y
CONFIG_ESP_CONSOLE_UART_BAUDRATE=921600
CONFIG_ESP_COREDUMP_ENABLE_TO_UART=y
```
